## conf/layer.conf
```bitbake
# We have a conf and classes directory, add to BBPATH
BBPATH .= ":${LAYERDIR}"

# We have recipes-* directories, add to BBFILES
BBFILES += "${LAYERDIR}/recipes-*/*/*.bb \
            ${LAYERDIR}/recipes-*/*/*.bbappend"

BBFILE_COLLECTIONS += "meta-rpilinux"
BBFILE_PATTERN_meta-rpilinux = "^${LAYERDIR}/"
BBFILE_PRIORITY_meta-rpilinux = "6"

LAYERDEPENDS_meta-rpilinux = " \
    core \
    meta-python \
    openembedded-layer \
    ros-common-layer \
    ros2-layer \
    ros2-jazzy-layer \
    rust-bin-layer \
"
LAYERSERIES_COMPAT_meta-rpilinux = "mickledore scarthgap"
LICENSE_FLAGS_ACCEPTED = "synaptics-killswitch"

ENABLE_SPI_BUS="1"
ENABLE_I2C="1"
ENABLE_UART="1"
BOOT_DELAY = "0"
BOOT_DELAY_MS = "0"
DISABLE_OVERSCAN = "1"
DISABLE_SPLASH = "1"
IMAGE_FSTYPES = "tar.xz ext3 ext4 rpi-sdimg"
KERNEL_MODULE_AUTOLOAD:rpi += "i2c-dev i2c-bcm2708"
INIT_MANAGER = "systemd"
DISTRO_FEATURES:append = " wifi"

ROS_VERSION ??= "2"
ROS_DISTRO ??= "jazzy"
```
